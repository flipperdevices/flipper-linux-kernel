// SPDX-License-Identifier: (GPL-2.0+ OR MIT)
/*
 * Copyright (c) 2026 Flipper FZCO
 */

/dts-v1/;

#include "rk3576-flipper-one.dtsi"

/ {
	model = "Flipper One rev. F0B0C1";
	compatible = "flipper,one-rev-f0b0c1", "rockchip,rk3576";
};

&gpio_vcc5v0 {
	vin-supply = <&vcc5v0_device_s0>;
};

&mcu {
	pinctrl-names = "default";
	pinctrl-0 = <&audio_headset_int &cpu_int>;
};

&vcc5v0_device_s0 {
	/*
	* Controlled by the GPIO expander pin P13, but turning it off
	* makes the expander I2C bus stuck and unrecoverable due to
	* the USB MUX misbehavior on the same bus
	*/
	regulator-boot-on;
	regulator-always-on;
	regulator-min-microvolt = <5000000>;
	regulator-max-microvolt = <5000000>;
};
