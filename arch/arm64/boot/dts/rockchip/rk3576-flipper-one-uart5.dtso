// SPDX-License-Identifier: (GPL-2.0+ OR MIT)
// SPDX-FileCopyrightText: 2026 Flipper FZCO
/*
 * DT-overlay to enable UART5 on the GPIO header on Flipper One
 */

/dts-v1/;
/plugin/;

&uart5 {
	pinctrl-names = "default";
	pinctrl-0 = <&uart5m1_xfer>;
	status = "okay";
};
