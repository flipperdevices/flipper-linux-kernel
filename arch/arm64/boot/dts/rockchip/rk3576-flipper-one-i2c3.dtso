// SPDX-License-Identifier: (GPL-2.0+ OR MIT)
// SPDX-FileCopyrightText: 2026 Flipper FZCO
/*
 * DT-overlay to enable I2C3 on the GPIO header on Flipper One
 */

/dts-v1/;
/plugin/;

&i2c3 {
	pinctrl-names = "default";
	pinctrl-0 = <&i2c3m0_xfer>;
	status = "okay";
};
