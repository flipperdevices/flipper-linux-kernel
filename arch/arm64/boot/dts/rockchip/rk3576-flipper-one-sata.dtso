// SPDX-License-Identifier: (GPL-2.0+ OR MIT)
// SPDX-FileCopyrightText: 2026 Flipper FZCO
/*
 * DT-overlay to switch the M.2 slot from PCIe mode to SATA (which shares the
 * same pins).
 */

/dts-v1/;
/plugin/;

&sata0 {
	status = "okay";
};

&pcie0 {
	status = "disabled";
};
