// SPDX-License-Identifier: (GPL-2.0+ OR MIT)
/*
 * DT-overlay to enable I2C4 on the GPIO header on Flipper One
 */

/dts-v1/;
/plugin/;

&i2c4 {
	pinctrl-names = "default";
	pinctrl-0 = <&i2c4m1_xfer>;
	status = "okay";
};
