// SPDX-License-Identifier: (GPL-2.0+ OR MIT)
/*
 * DT-overlay to enable PWM2 channel 6 on the GPIO header on Flipper One
 */

/dts-v1/;
/plugin/;

&pwm2_8ch_6 {
	pinctrl-names = "default";
	pinctrl-0 = <&pwm2m0_ch6>;
	status = "okay";
};
