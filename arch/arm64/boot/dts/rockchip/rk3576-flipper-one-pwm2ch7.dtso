// SPDX-License-Identifier: (GPL-2.0+ OR MIT)
/*
 * DT-overlay to enable PWM2 channel 7 on the GPIO header on Flipper One
 */

/dts-v1/;
/plugin/;

&pwm2_8ch_7 {
	pinctrl-names = "default";
	pinctrl-0 = <&pwm2m0_ch7>;
	status = "okay";
};
