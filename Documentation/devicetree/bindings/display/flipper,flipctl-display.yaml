## Documentation/devicetree/bindings/display/flipper,flipctl-display.yaml
```yaml
# SPDX-License-Identifier: (GPL-2.0-only OR BSD-2-Clause)
%YAML 1.2
---
$id: http://devicetree.org/schemas/display/flipper,one-display.yaml#
$schema: http://devicetree.org/meta-schemas/core.yaml#

title: Flipper One display

maintainers:
  - Alexey Charkov <alchark@flipper.net>

description:
  Flipper One is a handheld network multi-tool, which includes a custom
  grayscale LCD panel driven by an MCU accepting image contents over a SPI bus.
  The image data must consist of a full frame in each transmission, signalled
  by the "active" GPIO line. One byte per pixel is used, with 0 representing
  black and 255 white, lower two bits are discarded, and the expected frame
  size is 258x144 pixels of which the leftmost 256x144 are visible.

  SPI mode 3 is used, 16 bits per word, with a maximum frequency of 24MHz.

allOf:
  - $ref: /schemas/spi/spi-peripheral-props.yaml#

properties:
  compatible:
    enum:
      - flipper,one-display

  reg:
    maxItems: 1

  spi-max-frequency:
    maximum: 24000000

  active-gpios:
    maxItems: 1
    description: Frame data is being transmitted when this line is low.
      Bring it high to signal the end of frame.

required:
  - compatible
  - reg
  - active-gpios
  - spi-max-frequency

unevaluatedProperties: false

examples:
  - |
    #include <dt-bindings/gpio/gpio.h>
    spi {
        #address-cells = <1>;
        #size-cells = <0>;

        display@0 {
            compatible = "flipper,one-display";
            reg = <0>;
            active-gpios = <&gpio4 6 GPIO_ACTIVE_LOW>;
            spi-max-frequency = <20000000>;
            spi-rx-bus-width = <0>;
        };
    };
...
```

## Documentation/devicetree/bindings/display/flipper,one-display.yaml
```yaml
# SPDX-License-Identifier: (GPL-2.0-only OR BSD-2-Clause)
%YAML 1.2
---
$id: http://devicetree.org/schemas/display/flipper,one-display.yaml#
$schema: http://devicetree.org/meta-schemas/core.yaml#

title: Flipper One display

maintainers:
  - Alexey Charkov <alchark@flipper.net>

description:
  Flipper One is a handheld network multi-tool, which includes a custom
  grayscale LCD panel driven by an MCU accepting image contents over a SPI bus.
  The image data must consist of a full frame in each transmission, signalled
  by the "active" GPIO line. One byte per pixel is used, with 0 representing
  black and 255 white, lower two bits are discarded, and the expected frame
  size is 258x144 pixels of which the leftmost 256x144 are visible.

  The MCU expects SPI mode 3 (CPOL=1, CPHA=1), up to 24MHz frequency.

allOf:
  - $ref: /schemas/spi/spi-peripheral-props.yaml#

properties:
  compatible:
    enum:
      - flipper,one-display

  reg:
    maxItems: 1

  spi-cpha: true
  spi-cpol: true

  spi-max-frequency:
    maximum: 24000000

  active-gpios:
    maxItems: 1
    description: Frame data is being transmitted when this line is asserted.
      Deassert to signal the end of frame.

required:
  - compatible
  - reg
  - active-gpios
  - spi-max-frequency

unevaluatedProperties: false

examples:
  - |
    #include <dt-bindings/gpio/gpio.h>
    spi {
        #address-cells = <1>;
        #size-cells = <0>;

        display@0 {
            compatible = "flipper,one-display";
            reg = <0>;
            active-gpios = <&gpio4 6 GPIO_ACTIVE_LOW>;
            spi-max-frequency = <20000000>;
            spi-cpha;
            spi-cpol;
            spi-rx-bus-width = <0>;
        };
    };
...
```

## Documentation/devicetree/bindings/hwmon/ti,ina4230.yaml
```yaml
# SPDX-License-Identifier: (GPL-2.0 OR BSD-2-Clause)
%YAML 1.2
---
$id: http://devicetree.org/schemas/hwmon/ti,ina4230.yaml#
$schema: http://devicetree.org/meta-schemas/core.yaml#

title: Texas Instruments INA4230 quad-channel power monitors

maintainers:
  - Alexey Charkov <alchark@flipper.net>

description: |
  The INA4230 is a 48V quad-channel 16-bit current, voltage, power and energy
  monitor with an I2C interface.

  Datasheet:
    https://www.ti.com/product/INA4230

properties:
  compatible:
    enum:
      - ti,ina4230

  reg:
    maxItems: 1

  "#address-cells":
    description: Required only if a child node is present.
    const: 1

  "#size-cells":
    description: Required only if a child node is present.
    const: 0

  vs-supply:
    description: phandle to the regulator that provides the VS supply typically
      in range from 1.7 V to 5.5 V.

  ti,alert-polarity-active-high:
    description: Alert pin is asserted based on the value of Alert polarity Bit
      of the CONFIG2 register. Default value is 0, for which the alert pin
      toggles from high to low during faults. When this property is set, the
      corresponding register bit is set to 1, and the alert pin toggles from
      low to high during faults.
    $ref: /schemas/types.yaml#/definitions/flag

patternProperties:
  "^input@[0-3]$":
    description: The node contains optional child nodes for four channels.
      Each child node describes the information of input source. Input channels
      default to enabled in the chip. Unless channels are explicitly disabled
      in device-tree, input channels will be enabled.
    type: object
    additionalProperties: false
    properties:
      reg:
        description: Must be 0, 1, 2 or 3, corresponding to the IN1, IN2, IN3
          or IN4 ports of the INA4230, respectively.
        enum: [ 0, 1, 2, 3 ]

      label:
        description: name of the input source

      shunt-resistor-micro-ohms:
        description: shunt resistor value in micro-Ohm

      ti,maximum-expected-current-microamp:
        description: |
          This value indicates the maximum current in microamps that you can
          expect to measure with ina4230 in your circuit.

          This value will be used to calculate the Current_LSB to maximize the
          available precision while ensuring your expected maximum current fits
          within the chip's ADC range. It will also enable built-in shunt gain
          to increase ADC granularity by a factor of 4 if the provided maximum
          current / shunt resistance combination does not produce more than
          20.48 mV drop at the shunt.
        minimum: 32768
        maximum: 4294967295
        default: 32768000

    required:
      - reg

required:
  - compatible
  - reg

allOf:
  - $ref: hwmon-common.yaml#

unevaluatedProperties: false

examples:
  - |
    i2c {
        #address-cells = <1>;
        #size-cells = <0>;

        power-sensor@44 {
            compatible = "ti,ina4230";
            reg = <0x44>;
            vs-supply = <&vdd_3v0>;
            ti,alert-polarity-active-high;
            #address-cells = <1>;
            #size-cells = <0>;

            input@0 {
                reg = <0x0>;
                /*
                 * Input channels are enabled by default in the device and so
                 * to disable, must be explicitly disabled in device-tree.
                 */
                status = "disabled";
            };

            input@1 {
                reg = <0x1>;
                shunt-resistor-micro-ohms = <50000>;
                ti,maximum-expected-current-microamp = <300000>;
            };

            input@2 {
                reg = <0x2>;
                label = "VDD_5V";
                shunt-resistor-micro-ohms = <10000>;
                ti,maximum-expected-current-microamp = <5000000>;
            };

            input@3 {
                reg = <0x3>;
            };
        };
    };
```

## Documentation/devicetree/bindings/mfd/ugreen,dh2300-mcu.yaml
```yaml
# SPDX-License-Identifier: (GPL-2.0-only OR BSD-2-Clause)
%YAML 1.2
---
$id: http://devicetree.org/schemas/mfd/ugreen,dh2300-mcu.yaml#
$schema: http://devicetree.org/meta-schemas/core.yaml#

title: UGREEN NASync DH2300 embedded controller

maintainers:
  - Alexey Charkov <alchark@flipper.net>

description:
  The UGREEN NASync DH2300 NAS carries a HC32F005 microcontroller on I2C that
  acts as a board embedded controller. It gates power to the SATA drive bays
  through an internal register and apparently also serves as a watchdog
  (unconfirmed, as vendor kernel sources are unavailable, works without it)

properties:
  compatible:
    const: ugreen,dh2300-mcu

  reg:
    maxItems: 1

  regulator:
    type: object
    $ref: /schemas/regulator/regulator.yaml#
    unevaluatedProperties: false
    description:
      The SATA drive-bay power gate controlled by the MCU.

  watchdog-gpios:
    description:
      Optional GPIO line used to ping the hardware watchdog function of the MCU
    maxItems: 1

required:
  - compatible
  - reg

additionalProperties: false

examples:
  - |
    #include <dt-bindings/gpio/gpio.h>
    #include <dt-bindings/pinctrl/rockchip.h>

    i2c {
        #address-cells = <1>;
        #size-cells = <0>;

        embedded-controller@4c {
            compatible = "ugreen,dh2300-mcu";
            reg = <0x4c>;
            watchdog-gpios = <&gpio0 RK_PA0 GPIO_ACTIVE_LOW>;

            sata_power: regulator {
                regulator-name = "sata-power";
                vin-supply = <&vcc12v_dcin>;
            };
        };
    };
```

## drivers/media/platform/rockchip/rkcsi/Kconfig
```kconfig
config VIDEO_ROCKCHIP_CSI
	tristate "Rockchip MIPI CSI-2 Receiver"
	depends on VIDEO_DEV
	depends on ARCH_ROCKCHIP || COMPILE_TEST
	depends on V4L_PLATFORM_DRIVERS
	depends on PM && COMMON_CLK
	select MEDIA_CONTROLLER
	select V4L2_FWNODE
	select VIDEO_V4L2_SUBDEV_API
	help
	  This is a driver for Rockchip MIPI CSI-2 Receiver. It is featured
	  in various Rockchips SoCs, usually in combination with a Video
	  Capture (VICAP) unit (see Rockchip Camera Interface (CIF) driver).

	  To compile this driver as a module, choose M here: the module
	  will be called rockchip-mipi-csi.
```
