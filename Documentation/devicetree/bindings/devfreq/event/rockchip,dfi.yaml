## Documentation/devicetree/bindings/devfreq/event/rockchip,dfi.yaml
```yaml
# SPDX-License-Identifier: (GPL-2.0-only OR BSD-2-Clause)
%YAML 1.2
---
$id: http://devicetree.org/schemas/devfreq/event/rockchip,dfi.yaml#
$schema: http://devicetree.org/meta-schemas/core.yaml#

title: Rockchip DFI

maintainers:
  - Sascha Hauer <s.hauer@pengutronix.de>

properties:
  compatible:
    enum:
      - rockchip,rk3399-dfi
      - rockchip,rk3568-dfi
      - rockchip,rk3576-dfi
      - rockchip,rk3588-dfi

  clocks:
    minItems: 1
    maxItems: 4

  clock-names:
    minItems: 1
    maxItems: 4
    items:
      - enum:
          - pclk_ddr_mon
          - pclk_ddr_mon_ch0
      - const: pclk_ddr_mon_ch1
      - const: pclk_ddr_mon_ch2
      - const: pclk_ddr_mon_ch3

  interrupts:
    minItems: 1
    maxItems: 4

  reg:
    maxItems: 1

  rockchip,pmu:
    $ref: /schemas/types.yaml#/definitions/phandle
    description:
      Phandle to the syscon managing the "PMU general register files".

required:
  - compatible
  - interrupts
  - reg

allOf:
  - if:
      properties:
        compatible:
          contains:
            enum:
              - rockchip,rk3399-dfi
    then:
      properties:
        clocks:
          items:
            - description:
                clock driving the DDR monitoring logic for all channels
        clock-names:
          items:
            - const: pclk_ddr_mon
      required:
        - clocks
        - clock-names

  - if:
      properties:
        compatible:
          contains:
            enum:
              - rockchip,rk3576-dfi
    then:
      properties:
        clocks:
          items:
            - description:
                clock driving the DDR monitoring logic for memory channel 0
            - description:
                clock driving the DDR monitoring logic for memory channel 1
        clock-names:
          items:
            - const: pclk_ddr_mon_ch0
            - const: pclk_ddr_mon_ch1
      required:
        - clocks
        - clock-names

  - if:
      properties:
        compatible:
          contains:
            enum:
              - rockchip,rk3588-dfi
    then:
      properties:
        clocks:
          items:
            - description:
                clock driving the DDR monitoring logic for memory channel 0
            - description:
                clock driving the DDR monitoring logic for memory channel 1
            - description:
                clock driving the DDR monitoring logic for memory channel 2
            - description:
                clock driving the DDR monitoring logic for memory channel 3
        clock-names:
          items:
            - const: pclk_ddr_mon_ch0
            - const: pclk_ddr_mon_ch1
            - const: pclk_ddr_mon_ch2
            - const: pclk_ddr_mon_ch3

additionalProperties: false

examples:
  - |
    #include <dt-bindings/interrupt-controller/arm-gic.h>
    #include <dt-bindings/clock/rk3308-cru.h>

    bus {
      #address-cells = <2>;
      #size-cells = <2>;

      dfi: dfi@ff630000 {
        compatible = "rockchip,rk3399-dfi";
        reg = <0x00 0xff630000 0x00 0x4000>;
        interrupts = <GIC_SPI 131 IRQ_TYPE_LEVEL_HIGH 0>;
        rockchip,pmu = <&pmugrf>;
        clocks = <&cru PCLK_DDR_MON>;
        clock-names = "pclk_ddr_mon";
      };
    };

  - |
    bus {
      #address-cells = <2>;
      #size-cells = <2>;

      dfi_rk3588: dfi@fe060000 {
        compatible = "rockchip,rk3588-dfi";
        reg = <0x00 0xfe060000 0x00 0x10000>;
        clocks = <&cru 0x53>, <&cru 0x48>, <&cru 0x49>, <&cru 0x54>;
        clock-names = "pclk_ddr_mon_ch0", "pclk_ddr_mon_ch1",
                      "pclk_ddr_mon_ch2", "pclk_ddr_mon_ch3";
        interrupts =  <GIC_SPI 28 IRQ_TYPE_LEVEL_HIGH 0>,
                      <GIC_SPI 38 IRQ_TYPE_LEVEL_HIGH 0>,
                      <GIC_SPI 48 IRQ_TYPE_LEVEL_HIGH 0>,
                      <GIC_SPI 58 IRQ_TYPE_LEVEL_HIGH 0>;
        rockchip,pmu = <&pmugrf>;
      };
    };
```

## Documentation/devicetree/bindings/nvmem/layouts/rockchip,rk3576-otp-cpuid.yaml
```yaml
# SPDX-License-Identifier: (GPL-2.0 OR BSD-2-Clause)
%YAML 1.2
---
$id: http://devicetree.org/schemas/nvmem/layouts/rockchip,rk3576-otp-cpuid.yaml#
$schema: http://devicetree.org/meta-schemas/core.yaml#

title: NVMEM layout of the CPU ID in Rockchip OTP memory

maintainers:
  - Alexey Charkov <alchark@flipper.net>

description: |
  Rockchip SoCs are shipped with a unique CPU ID programmed into their
  internal OTP memory. Rockchip bootloaders derive Ethernet MAC addresses
  from it, so that boards which have no dedicated storage for a MAC address
  still get a stable one. The addresses are computed by hashing the lowercase
  hexadecimal representation of the CPU ID with SHA-256 and taking the first
  six octets of the digest, with the multicast bit cleared and the locally
  administered bit set.

  The location of the CPU ID within the OTP memory differs between SoCs,
  hence the SoC specific compatible.

select: false

properties:
  compatible:
    const: rockchip,rk3576-otp-cpuid

  mac-address:
    type: object
    description:
      MAC address derived from the CPU ID. The first argument of the phandle
      selects one of the two addresses that can be derived (can be 0 or 1).

    properties:
      "#nvmem-cell-cells":
        const: 1

    additionalProperties: false

required:
  - compatible

additionalProperties: false

examples:
  - |
    #include <dt-bindings/clock/rockchip,rk3576-cru.h>
    #include <dt-bindings/reset/rockchip,rk3576-cru.h>

    soc {
        #address-cells = <2>;
        #size-cells = <2>;

        otp@2a580000 {
            compatible = "rockchip,rk3576-otp";
            reg = <0x0 0x2a580000 0x0 0x400>;
            clocks = <&cru CLK_OTPC_NS>, <&cru PCLK_OTPC_NS>,
                     <&cru CLK_OTP_PHY_G>;
            clock-names = "otp", "apb_pclk", "phy";
            resets = <&cru SRST_OTPC_NS>, <&cru SRST_P_OTPC_NS>;
            reset-names = "otp", "apb";

            nvmem-layout {
                compatible = "rockchip,rk3576-otp-cpuid";

                otp_mac_address: mac-address {
                    #nvmem-cell-cells = <1>;
                };
            };
        };
    };
```

## Documentation/devicetree/bindings/phy/rockchip,rk3588-hdptx-phy.yaml
```yaml
# SPDX-License-Identifier: (GPL-2.0-only OR BSD-2-Clause)
%YAML 1.2
---
$id: http://devicetree.org/schemas/phy/rockchip,rk3588-hdptx-phy.yaml#
$schema: http://devicetree.org/meta-schemas/core.yaml#

title: Rockchip SoC HDMI/eDP Transmitter Combo PHY

maintainers:
  - Cristian Ciocaltea <cristian.ciocaltea@collabora.com>

properties:
  compatible:
    oneOf:
      - enum:
          - rockchip,rk3588-hdptx-phy
      - items:
          - enum:
              - rockchip,rk3576-hdptx-phy
          - const: rockchip,rk3588-hdptx-phy

  reg:
    maxItems: 1

  clocks:
    items:
      - description: Reference clock
      - description: APB clock

  clock-names:
    items:
      - const: ref
      - const: apb

  "#clock-cells":
    const: 0

  "#phy-cells":
    const: 0

  resets:
    minItems: 4
    maxItems: 7

  reset-names:
    minItems: 4
    maxItems: 7

  avdd-0v75-supply:
    description:
      Supply for the 0.75V digital and analog power pins of the PHY, i.e.
      VDD_0V75 and AVDD_0V75 on RK3588, AVDDD0V75 and AVDDC0V75 on RK3576.

  vddio-1v8-supply:
    description:
      Supply for the 1.8V common and I/O power pins of the PHY, i.e.
      VDD_CMN_1V8 and VDD_IO_1V8 on RK3588, AVDDCMN1V8 and AVDDIO1V8 on
      RK3576.

  rockchip,grf:
    $ref: /schemas/types.yaml#/definitions/phandle
    description: Some PHY related data is accessed through GRF regs.

required:
  - compatible
  - reg
  - clocks
  - clock-names
  - "#phy-cells"
  - resets
  - reset-names
  - rockchip,grf

allOf:
  - if:
      properties:
        compatible:
          contains:
            enum:
              - rockchip,rk3576-hdptx-phy
    then:
      properties:
        resets:
          minItems: 4
          maxItems: 4
        reset-names:
          items:
            - const: apb
            - const: init
            - const: cmn
            - const: lane
    else:
      properties:
        resets:
          minItems: 7
          maxItems: 7
        reset-names:
          items:
            - const: phy
            - const: apb
            - const: init
            - const: cmn
            - const: lane
            - const: ropll
            - const: lcpll

additionalProperties: false

examples:
  - |
    #include <dt-bindings/clock/rockchip,rk3588-cru.h>
    #include <dt-bindings/reset/rockchip,rk3588-cru.h>

    soc {
      #address-cells = <2>;
      #size-cells = <2>;

      phy@fed60000 {
        compatible = "rockchip,rk3588-hdptx-phy";
        reg = <0x0 0xfed60000 0x0 0x2000>;
        clocks = <&cru CLK_USB2PHY_HDPTXRXPHY_REF>, <&cru PCLK_HDPTX0>;
        clock-names = "ref", "apb";
        #phy-cells = <0>;
        resets = <&cru SRST_HDPTX0>, <&cru SRST_P_HDPTX0>,
                 <&cru SRST_HDPTX0_INIT>, <&cru SRST_HDPTX0_CMN>,
                 <&cru SRST_HDPTX0_LANE>, <&cru SRST_HDPTX0_ROPLL>,
                 <&cru SRST_HDPTX0_LCPLL>;
        reset-names = "phy", "apb", "init", "cmn", "lane", "ropll", "lcpll";
        avdd-0v75-supply = <&avdd_0v75_s0>;
        vddio-1v8-supply = <&avcc_1v8_s0>;
        rockchip,grf = <&hdptxphy_grf>;
      };
    };
```

## Documentation/devicetree/bindings/power/reset/syscon-reboot-mode.yaml
```yaml
# SPDX-License-Identifier: GPL-2.0-only
%YAML 1.2
---
$id: http://devicetree.org/schemas/power/reset/syscon-reboot-mode.yaml#
$schema: http://devicetree.org/meta-schemas/core.yaml#

title: Generic SYSCON reboot mode driver

maintainers:
  - Sebastian Reichel <sre@kernel.org>

description: |
  This driver gets reboot mode magic value from reboot-mode driver
  and stores it in a SYSCON mapped register. Then the bootloader
  can read it and take different action according to the magic
  value stored. The SYSCON mapped register is retrieved from the
  parental dt-node plus the offset. So the SYSCON reboot-mode node
  should be represented as a sub-node of a "syscon", "simple-mfd" node.

properties:
  compatible:
    const: syscon-reboot-mode

  mask:
    $ref: /schemas/types.yaml#/definitions/uint32
    description: Update only the register bits defined by the mask (32 bit)

  offset:
    $ref: /schemas/types.yaml#/definitions/uint32
    description: Offset in the register map for the mode register (in bytes)

allOf:
  - $ref: reboot-mode.yaml#

patternProperties:
  "^mode-.*$":
    maxItems: 1

  "^[a-z0-9]+(-[a-z0-9]+)*-supply$":
    description:
      Supply that has to be powered for whatever program acts on the mode.
      That could be a boot ROM with no access to regulators, and a warm reset
      leaves them as the previously running system left them and not necessarily
      what their expected out-of-reboot state is. Any supply described here is
      enabled when a mode is requested, and stays enabled.

unevaluatedProperties: false

required:
  - compatible
  - offset

examples:
  - |
    #include <dt-bindings/soc/rockchip,boot-mode.h>

    reboot-mode {
      compatible = "syscon-reboot-mode";
      offset = <0x40>;
      mode-normal = <BOOT_NORMAL>;
      mode-recovery = <BOOT_RECOVERY>;
      mode-bootloader = <BOOT_FASTBOOT>;
      mode-loader = <BOOT_BL_DOWNLOAD>;
    };
...
```

## drivers/nvmem/layouts/Kconfig
```kconfig
# SPDX-License-Identifier: GPL-2.0

config NVMEM_LAYOUTS
	bool
	depends on OF

if NVMEM_LAYOUTS

menu "Layout Types"

config NVMEM_LAYOUT_SL28_VPD
	tristate "Kontron sl28 VPD layout support"
	select CRC8
	help
	  Say Y here if you want to support the VPD layout of the Kontron
	  SMARC-sAL28 boards.

	  If unsure, say N.

config NVMEM_LAYOUT_ONIE_TLV
	tristate "ONIE tlv support"
	select CRC32
	help
	  Say Y here if you want to support the Open Compute Project ONIE
	  Type-Length-Value standard table.

	  If unsure, say N.

config NVMEM_LAYOUT_ROCKCHIP_OTP_CPUID
	tristate "Rockchip OTP CPU ID layout support"
	default ARCH_ROCKCHIP
	select CRYPTO_LIB_SHA256
	help
	  Say Y here if you want to expose the MAC addresses that Rockchip
	  bootloaders derive from the CPU ID programmed into the OTP memory of
	  Rockchip SoCs. Boards which have no other source of MAC addresses
	  need this to get stable ones when the bootloader does not patch them
	  into the device tree.

	  If unsure, say N.

config NVMEM_LAYOUT_U_BOOT_ENV
	tristate "U-Boot environment variables layout"
	select CRC32
	select GENERIC_NET_UTILS
	help
	  U-Boot stores its setup as environment variables. This driver adds
	  support for verifying & exporting such data. It also exposes variables
	  as NVMEM cells so they can be referenced by other drivers.

	  If unsure, say N.

endmenu

endif
```

## drivers/staging/aic8800/Kconfig
```kconfig
# SPDX-License-Identifier: GPL-2.0-only

config AIC8800D80_USB
	tristate "AICSemi AIC8800D80 USB support"
	depends on WLAN && USB && CFG80211
	select FW_LOADER
	help
	  This staging driver supports the AICSemi AIC8800D80 USB Wi-Fi
	  device used on the Radxa ROCK 4D. The device initially enumerates
	  as USB ID a69c:8d80. The aic_load_fw module loads its firmware,
	  after which it re-enumerates as a69c:8d81. The aic8800_fdrv
	  module then provides the cfg80211 network interface.
	  To compile this driver as modules, choose M here. The modules will
	  be called aic_load_fw and aic8800_fdrv.
```
